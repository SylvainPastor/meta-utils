## conf/layer.conf
```bitbake
# We have a conf and classes directory, add to BBPATH
BBPATH .= ":${LAYERDIR}"

# We have recipes-* directories, add to BBFILES
BBFILES += "${LAYERDIR}/recipes-*/*/*.bb \
            ${LAYERDIR}/recipes-*/*/*.bbappend"

BBFILE_COLLECTIONS += "meta-utils"
BBFILE_PATTERN_meta-utils = "^${LAYERDIR}/"
BBFILE_PRIORITY_meta-utils = "6"

LAYERVERSION_meta-utils = "1"
LAYERSERIES_COMPAT_meta-utils = "scarthgap styhead"

# Layer dependencies
LAYERDEPENDS_meta-utils = " \
    core \
    meta-oe \
    meta-networking \
"

# Layer description
LAYERDEPENDS_meta-utils[meta-oe] = "meta-openembedded/meta-oe"
LAYERDEPENDS_meta-utils[meta-networking] = "meta-openembedded/meta-networking"
```
